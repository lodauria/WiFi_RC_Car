## esp32_sender/main/Kconfig.projbuild
```kconfig
menu "WiFi Configuration"

    config ESP_WIFI_SSID
        string "WiFi SSID"
        default "myssid"
        help
            SSID (network name) for the example to connect to.

    config ESP_WIFI_PASSWORD
        string "WiFi Password"
        default "mypassword"
        help
            WiFi password (WPA or WPA2) for the example to use.

    config ESP_IP_ADDR
        string "ESP static IP address"
        default "192.168.1.152"
        help
            The ESP need to have a static IP address

    config ESP_IP_GW
        string "Gateway IP address"
        default "192.168.1.1"
        help
            Tipically the router IP address

endmenu
```
